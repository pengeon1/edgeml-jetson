## meta-edgeml/conf/layer.conf
```bitbake
# Project layer for the EdgeML Jetson Nano image.
BBPATH .= ":${LAYERDIR}"
BBFILES += "${LAYERDIR}/recipes-*/*/*.bb ${LAYERDIR}/recipes-*/*/*.bbappend"
BBFILE_COLLECTIONS += "edgeml"
BBFILE_PATTERN_edgeml = "^${LAYERDIR}/"
BBFILE_PRIORITY_edgeml = "10"
LAYERVERSION_edgeml = "1"
LAYERSERIES_COMPAT_edgeml = "kirkstone"
LAYERDEPENDS_edgeml = "core"
```
